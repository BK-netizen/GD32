/*!
 * 文件名称： bsp_oled.c
 * 描    述： OLED驱动文件
 * 版本：     2023-12-03, V1.0
*/

/*
* GD32H757海棠派开发板V1.0
* 聚沃科技官网：https://www.gd32bbs.com/
* B站视频教程：https://space.bilibili.com/475462605
* CSDN文档教程：https://gd32mcu.blog.csdn.net/
* 聚沃开发板购买：https://juwo.taobao.com
* GD技术交流QQ群：859440462
* GD官方开发板、样品购买，咨询Q：87205168  咨询V：13905102619
* GD32 MCU方案移植、方案开发，咨询Q：87205168  咨询V：13905102619
* Copyright@苏州聚沃电子科技有限公司，盗版必究。
*/

#include "bsp_oled.h"
#include "driver_public.h"
#include "driver_gpio.h"
#include "driver_i2c.h"

/* OLED IIC模块及引脚注册 */
I2C_SCL_GPIO_DEF(OLED_I2C,B,10,GPIO_AF_4);
I2C_SDA_GPIO_DEF(OLED_I2C,B,11,GPIO_AF_4);
I2C_DEF(OLED_I2C,I2C1,1000000,0x60,MODE_POLL); 

/* 6*8 matrix */
const uint8_t C6X8[][6] = {
0x00, 0x00, 0x00, 0x00, 0x00, 0x00,// sp
0x00, 0x00, 0x00, 0x2f, 0x00, 0x00,// !
0x00, 0x00, 0x07, 0x00, 0x07, 0x00,// "
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0x14, 0x14, 0x14, 0x14, 0x14, 0x14,// horiz lines
};

/* 8*16 matrix */
const uint8_t C8X16[] =
{
  0x00,0x00,0x00,0x00,0x00,0x00,0x00,0x00,0x00,0x00,0x00,0x00,0x00,0x00,0x00,0x00,// 0
  0x00,0x00,0x00,0xF8,0x00,0x00,0x00,0x00,0x00,0x00,0x00,0x33,0x30,0x00,0x00,0x00,//! 1
  0x00,0x10,0x0C,0x06,0x10,0x0C,0x06,0x00,0x00,0x00,0x00,0x00,0x00,0x00,0x00,0x00,//" 2
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  0x00,0x06,0x01,0x01,0x02,0x02,0x04,0x04,0x00,0x00,0x00,0x00,0x00,0x00,0x00,0x00,//~ 94
};

const unsigned char gImage_juwo[] = { /* 0X01,0X01,0X80,0X00,0X20,0X00, */
0x00,0x00,0xC0,0xE0,0xF0,0xF8,0xFC,0xFC,0xFE,0xFE,0xFE,0xFF,0xFF,0xFF,0xFF,0xFF,
0xFF,0xFF,0xFF,0xFF,0xFF,0xFF,0xFF,0xFF,0xFF,0xFF,0xFF,0xFF,0xFF,0xFF,0xFF,0xFF,
0xFF,0xFF,0xFF,0xFF,0xFF,0xFF,0xFF,0xFF,0xFF,0xFF,0x7F,0x3F,0x1F,0x0F,0x07,0x07,
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0xFF,0xFF,0xFF,0xFF,0xFF,0x7F,0x7F,0x7F,0x3F,0x3F,0x1F,0x0F,0x07,0x03,0x00,0x00,

};

/* logo matrix */
const unsigned char gImage_gd_logo[688] = {

0X00,0X00,0X00,0X00,0X00,0X00,
0X00,0X00,0X00,0X00,0X00,0X00,0X00,0X00,0X00,0X00,0X00,0X00,0X00,0X00,0X00,0X00,
0X00,0X00,0X00,0X00,0X00,0X00,0X00,0X00,0X80,0XC0,0XE0,0XF0,0XF0,0XF8,0XF8,0XFC,
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0X00,0X07,0X0F,0X0C,0X0C,0X0C,0X0C,0X00,0X07,0X0F,0X0D,0X0D,0X0D,0X0D,0X0D,0X01,
};

const unsigned char gImage_juwo2[] = { 
0x00,0x00,0x00,0xC0,0xF0,0xF8,0xFC,0xFC,0xFC,0x7C,0x7C,0x7C,0x7C,0x7C,0x7C,0x7C,
0x7C,0x7C,0x7C,0x7C,0x7C,0x7C,0x7C,0xBC,0xDC,0xEC,0xF4,0xF0,0xF8,0xFC,0xF8,0xF0,
0xE0,0x00,0x00,0x00,0x00,0x70,0xF0,0xF0,0xF0,0xF0,0xF0,0xF0,0xF0,0xF0,0xF0,0x70,
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0x00,0x00,0x00,0x00,0x00,0x00,0x00,0x00,0x00,0x00,0x00,0x00,0x00,0x00,0x00,0x00,

};

/* 静态函数声明 */
static void bsp_i2c_config(void);
static Drv_Err bsp_oled_write_byte(uint8_t dat, oled_cd_selection type);
static void bsp_oled_set_pos(uint8_t x, uint8_t y);
static uint32_t bsp_oled_pow(uint8_t m,uint8_t n);

/*!
* 说明     BSP OLED初始化
* 输入     无
* 返回值   无
*/
Drv_Err bsp_oled_init(void)
{
    bsp_i2c_config();                                   /* IIC接口初始化 */

   if(DRV_ERROR==bsp_oled_write_byte(0xAE,OLED_CMD))                 /* 关闭oled 显示 */
   {
        return DRV_ERROR;
   }

    bsp_oled_write_byte(0x81,OLED_CMD);                 /* 设置对比度控制寄存器 */
    bsp_oled_write_byte(BRIGHTNESS,OLED_CMD);           /* 设置对比度, 0x00-0xff */

    bsp_oled_write_byte(0xA0,OLED_CMD);                 /* 设置seg/row映射，row地址127映射到seg0 */
    bsp_oled_write_byte(0xC0,OLED_CMD);                 /* 设置com/row扫描方向，从com[n-1]扫描到com0 */

    bsp_oled_write_byte(0xD5,OLED_CMD);                 /* 设置显示时钟分频比/振荡器频率 */
    bsp_oled_write_byte(0x80,OLED_CMD);                 /* 分频比为1，使用默认的内部时钟*/
    bsp_oled_write_byte(0xA8,OLED_CMD);                 /* 设置多路复用比率, 0x0f-0x3f */
    bsp_oled_write_byte(0x3F,OLED_CMD);                 /* 1/64 占空比 */

    bsp_oled_write_byte(0xD3,OLED_CMD);                 /* 通过com设置0d~63d的垂直偏移 */
    bsp_oled_write_byte(0x00,OLED_CMD);                 /* 不偏移 */

    bsp_oled_write_byte(0xD9,OLED_CMD);                 /* 设置预充电时间 */
    bsp_oled_write_byte(0xF1,OLED_CMD);                 /* 将预充电设置为15个时钟，将放电设置为1个时钟 */

    bsp_oled_write_byte(0xDA,OLED_CMD);                 /* 设置com引脚硬件配置 */
    bsp_oled_write_byte(0x12,OLED_CMD);                 /* 顺序com引脚配置和禁用com左/右重映射 */

    bsp_oled_write_byte(0xDB,OLED_CMD);                 /* 调整Vcom调节器输出 */
    bsp_oled_write_byte(0x30,OLED_CMD);                 /* 设置 Vcom 为 0.83Vcc */

    bsp_oled_write_byte(0x20,OLED_CMD);                 /* 设置存储器寻址模式， 0x00-0x02 */
    bsp_oled_write_byte(0x02,OLED_CMD);                 /* 页面寻址模式 */

    bsp_oled_write_byte(0x8D,OLED_CMD);                 /* 电荷泵设置 */
    bsp_oled_write_byte(0x14,OLED_CMD);                 /* 使能电荷泵*/

    bsp_oled_write_byte(0xA4,OLED_CMD);                 /* 禁用整个显示, 0xA4 or 0xA5 */

    bsp_oled_write_byte(0xA6,OLED_CMD);                 /* 设置正常显示，0为OFF显示，1为ON显示*/

    bsp_oled_write_byte(0xAF,OLED_CMD);                 /* 正常模式或睡眠模式, 0xAF or 0xAE */

    bsp_oled_clear(0);
    
    return DRV_SUCCESS;
}

/*!
* 说明     OLED显示图片
* 输入[1]  x:图片显示的起始x坐标
* 输入[2]  y:图片显示的起始y坐标
* 输入[3]  x_res:图片X轴分辨率
* 输入[4]  x_res:图片y轴分辨率
* 输入[5]  pbuff:图片数组地址
* 返回值   无
*/
void bsp_oled_logo(uint8_t x, uint8_t y, uint8_t x_res, uint8_t y_res, uint8_t *pbuff)
{
    uint8_t i,n;
	  uint8_t y_num;
	  uint16_t pixel;
	  pixel = x_res*y_res;
    if(y_res%8>0)
		{
			y_num = y_res/8 +1;
		}else{
	  y_num = y_res/8;
		}
	  
    /* 显示log */
    for(i=0;i<y_num;i++){
        /* 设置页面寻址模式的页面起始地址(B0h~B7h) */
        bsp_oled_write_byte (0xB0+i,OLED_CMD);
        /* 为页面寻址模式设置低四位列起始地址(00h~0Fh) */
        bsp_oled_write_byte (0x00,OLED_CMD);
        /* 为页面寻址模式设置高四位列起始地址(10h~1Fh) */
        bsp_oled_write_byte (0x10,OLED_CMD);
			  /* 设置坐标 */
        bsp_oled_set_pos(x,y+i);
        /* l传输图片数据 */
        for(n=0;n<x_res;n++){
					  if(i*x_res+n<pixel)
						{
            bsp_oled_write_byte(pbuff[i*x_res+n],OLED_DATA);
						}else{
							break;
						}
        }
    }
}

/*!
* 说明     清除OLED
* 输入[1]  start_page:起始行 0-7
* 返回值   无
*/
void bsp_oled_clear(uint8_t start_page)
{
    uint8_t i,n;
    /* 显示更新 */
    for(i=start_page;i<8;i++){
        bsp_oled_write_byte (0xB0+i,OLED_CMD);
        bsp_oled_write_byte (0x00,OLED_CMD);
        bsp_oled_write_byte (0x10,OLED_CMD);

        for(n=0;n<128;n++){
            bsp_oled_write_byte(0,OLED_DATA);
        }
    }
}

/*!
* 说明     显示字符
* 输入[1]  x:显示X坐标 0-127
* 输入[2]  y:显示y坐标 0-7
* 输入[3]  ch:显示字符
* 输入[4]  size:显示格式
* 返回值   无
*/
void bsp_oled_showchar(uint8_t x, uint8_t y, uint8_t ch, oled_font size)
{
    uint8_t c = 0, i = 0;

    c = ch - ' ';

    if(x > MAX_COLUMN-1){
        x = 0;
        y = y + 2;
    }

    if(FONT_8_16 == size){
        bsp_oled_set_pos(x,y);
        for(i=0;i<8;i++)
        bsp_oled_write_byte(C8X16[c*16+i],OLED_DATA);

        bsp_oled_set_pos(x,y+1);
        for(i=0;i<8;i++)
        bsp_oled_write_byte(C8X16[c*16+i+8],OLED_DATA);

    }else{
        bsp_oled_set_pos(x,y);
        for(i=0;i<6;i++)
        bsp_oled_write_byte(C6X8[c][i],OLED_DATA);
    }
}

/*!
* 说明     显示数字
* 输入[1]  x:显示X坐标 0-127
* 输入[2]  y:显示y坐标 0-7
* 输入[3]  num:显示数字
* 输入[4]  len:数字长度
* 输入[5]  size:格式类型
* 返回值   无
*/
void bsp_oled_shownum(uint8_t x, uint8_t y, uint16_t num, uint8_t len, oled_font size)
{
    uint8_t t, temp;
    uint8_t enshow = 0;
    uint8_t offset;

    if(FONT_8_16 != size){
        offset = 6;
    }else{
        offset = 8;
    }

    for(t=0;t<len;t++){
        temp = (num/bsp_oled_pow(10,len-t-1))%10;
        if((enshow==0)&&(t<(len-1))){
            if(temp==0){
                bsp_oled_showchar(x+offset*t,y,' ',size);
                continue;
            }else enshow = 1; 
        }
        bsp_oled_showchar(x+offset*t,y,temp+'0',size); 
    }
}

/*!
* 说明     显示字符串
* 输入[1]  x:显示X坐标 0-127
* 输入[2]  y:显示y坐标 0-7
* 输入[3]  ch:显字符串指针
* 输入[4]  size:格式类型
* 返回值   无
*/
void bsp_oled_showstring(uint8_t x, uint8_t y, uint8_t *ch, oled_font size)
{
    uint8_t j=0;

    while(ch[j]!='\0'){
        bsp_oled_showchar(x,y,ch[j],size);
        x += 8;
        if(x>120){
            x = 0;
            y += 2;
        }
            j++;
    }
}

/*!
* 说明     IIC配置
* 输入     无
* 返回值   无
*/
static void bsp_i2c_config(void)
{
	driver_i2c_init(&OLED_I2C);
}

/*!
* 说明     写数据到OLED模块
* 输入[1]  data:需要写入的数据
* 输入[2]  type:数据类型
* 返回值   无
*/
static Drv_Err bsp_oled_write_byte(uint8_t data, oled_cd_selection type)
{
    uint8_t tx_buf[2];

    if(type){
        tx_buf[0] = 0x40;
    }else{
        tx_buf[0] = 0x00;
    }
    tx_buf[1]=data;
    
    return driver_i2c_poll_write(&OLED_I2C,OLED_ADDR,tx_buf,2);
}

/*!
* 说明     将x-y坐标系转换为页面列坐标系
* 输入[1]  x:x坐标
* 输入[2]  y:y坐标
* 返回值   无
*/
static void bsp_oled_set_pos(uint8_t x, uint8_t y) 
{
    x=x+2;
    /* set page start address for page addressing mode */
    bsp_oled_write_byte(0xb0+y,OLED_CMD);
    /* set higher column start address */
    bsp_oled_write_byte(((x&0xf0)>>4)|0x10,OLED_CMD);
    /* set lower column start address */
    bsp_oled_write_byte((x&0x0f),OLED_CMD);
}

/*!
* 说明     幂计算
* 输入[1]  m:基数
* 输入[2]  n:索引号
* 返回值   计算结果
*/
static uint32_t bsp_oled_pow(uint8_t m,uint8_t n)
{
    uint32_t result = 1;

    while(n--){
        result*=m;
    }

    return result;
}
